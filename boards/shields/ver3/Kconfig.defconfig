## boards/shields/ver3/Kconfig.defconfig
```kconfig
if SHIELD_VER3_RIGHT

config ZMK_KEYBOARD_NAME
    default "ver3"

endif

if SHIELD_VER3_LEFT || SHIELD_VER3_RIGHT

config ZMK_SPLIT
    default y

endif
```

## boards/shields/ver3/Kconfig.shield
```kconfig
config SHIELD_VER3_LEFT
    def_bool $(shields_list_contains,ver3_left)
config SHIELD_VER3_RIGHT
    def_bool $(shields_list_contains,ver3_right)
```
